## build/conf/bblayers.conf
```bitbake
# POKY_BBLAYERS_CONF_VERSION is increased each time build/conf/bblayers.conf
# changes incompatibly
POKY_BBLAYERS_CONF_VERSION = "2"

BBPATH = "${TOPDIR}"
BBFILES ?= ""

BBLAYERS ?= ""
BBLAYERS += " ${TOPDIR}/../meta"
BBLAYERS += " ${TOPDIR}/../meta-poky"
BBLAYERS += " ${TOPDIR}/../meta-yocto-bsp"
BBLAYERS += " ${TOPDIR}/../layers/meta-openembedded/meta-oe"
BBLAYERS += " ${TOPDIR}/../layers/meta-openembedded/meta-multimedia"
BBLAYERS += " ${TOPDIR}/../layers/meta-openembedded/meta-networking"
BBLAYERS += " ${TOPDIR}/../layers/meta-openembedded/meta-python"
BBLAYERS += " ${TOPDIR}/../layers/meta-openembedded/meta-filesystems"
BBLAYERS += " ${TOPDIR}/../layers/meta-intel"
BBLAYERS += " ${TOPDIR}/../layers/meta-clang"
BBLAYERS += " ${TOPDIR}/../layers/meta-browser/meta-chromium"
#BBLAYERS += " ${TOPDIR}/../layers/meta-browser/meta-firefox"

#BBLAYERS += " ${TOPDIR}/../layers/meta-games"
BBLAYERS += " ${TOPDIR}/../layers/meta-plex"
BBLAYERS += " ${TOPDIR}/../layers/meta-python2"

I_SWEAR_TO_MIGRATE_TO_PYTHON3 = "yes"
```
